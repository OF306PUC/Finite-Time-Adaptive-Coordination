## CMakeLists.txt
```
cmake_minimum_required(VERSION 3.20.0)

find_package(Zephyr REQUIRED HINTS $ENV{ZEPHYR_BASE})
project(NONE)

# NORDIC SDK APP START
target_sources(app PRIVATE
  src/main.c
  src/broadcaster.c
  src/observer.c
  src/serial.c
  src/consensus.c
)

# NORDIC SDK APP END
zephyr_library_include_directories(.)
```

## prj.conf
```kconfig
# Enable logger module
CONFIG_LOG=y

# Enable button and LED library 
CONFIG_DK_LIBRARY=y

# Enable BT-LE
CONFIG_BT=y
CONFIG_BT_DEVICE_NAME="LABCTRL"
CONFIG_BT_BROADCASTER=y
CONFIG_BT_OBSERVER=y

# Enable the serial driver in asynchronous mode
CONFIG_SERIAL=y
CONFIG_UART_ASYNC_API=y

# Increase stack size for the main thread and System Workqueue
CONFIG_SYSTEM_WORKQUEUE_STACK_SIZE=2048
CONFIG_MAIN_STACK_SIZE=2048
```

## src/main.c
```c
#include <zephyr/kernel.h>
#include <zephyr/logging/log.h>
#include <dk_buttons_and_leds.h>
#include <zephyr/bluetooth/bluetooth.h>
#include <zephyr/bluetooth/gap.h>
#include <string.h> 

#include "coordination_task.h"
#include "common.h"
#include "observer.h"
#include "broadcaster.h"
#include "serial.h"

// Register the logger for this module
LOG_MODULE_REGISTER(Module_Main, LOG_LEVEL_INF);

/**
 * Led status
 */
#define LED_STATUS                     DK_LED1
/**
 * Thread stack size and priority
 */
#define APP_STACK_SIZE                 3072
#define THREAD_SLOW_NETWORK_PRIORITY   7
#define THREAD_FAST_DYNAMICS_PRIORITY  5

// --- TIMER, SEMAPHORE AND MUTEX structs ---
static struct k_timer dynamics_timer;
static struct k_timer network_timer;
static struct k_mutex coordination_mutex;
static struct k_sem dynamics_sem;
static struct k_sem network_sem;

/**
 * Function declarations: --------------------------------------------------------------
 */
static void leds_init(void);                          // Auxiliary function for starting LEDs
static void bt_init(void);                            // Auxiliary function for starting Bluetooth
static void dynamics_thread(void);                    // Dedicated thread for 1ms dynamics (if not discrete time)
static void network_fetching_thread(void);            // Slow network/logging thread (body of original thread_coordination_app)
static void dynamics_timer_cb(struct k_timer *dummy); // High-frequency dynamics timer callback
static void network_timer_cb(struct k_timer *dummy);  // Slow network timer callback
/*
 * -------------------------------------------------------------------------------------
 */

/**
 * --- THREAD DEFINITIONS ---
 * The fast thread (P=5) handles the 1ms dynamics via a semaphore clock.
 * The slow thread (P=7) handles network I/O and logging.
 */
K_THREAD_DEFINE(dynamics_thread_id, APP_STACK_SIZE,
                dynamics_thread, NULL, NULL, NULL,
                THREAD_FAST_DYNAMICS_PRIORITY, 0, 0);

// Assuming thread_coordination_app should execute the thread_slow_network logic
K_THREAD_DEFINE(thread_coordination_id, APP_STACK_SIZE, network_fetching_thread,
                NULL, NULL, NULL, THREAD_SLOW_NETWORK_PRIORITY, 0, 0);

/**
 * Main thread (entry point of the program):
 */
int main(void) {
    int blink_status = 0;

    coordination_params_init(); // Initialize coordination parameters
    leds_init();
    bt_init();
    serial_init();

    // Original k_work_init and k_timer_init are replaced/modified:
    k_mutex_init(&coordination_mutex);
    k_sem_init(&dynamics_sem, 0, 1);
    k_sem_init(&network_sem,  0, 1);
    k_timer_init(&dynamics_timer, dynamics_timer_cb, NULL);
    k_timer_init(&network_timer,  network_timer_cb,  NULL);

    while (1) {
        dk_set_led(LED_STATUS, (++blink_status) % 2);
        k_sleep(K_MSEC(1000)); // Simple blink, non-critical
    }
}

/**
 * Function definitions:
 */
static void leds_init(void) {
    int err = dk_leds_init();
    if (err) {
        LOG_ERR("Status LED failed to start (err %d)\n", err);
        return;
    }
    LOG_INF("Status LED successfully started\n");
}

static void bt_init(void) {
    int err = bt_enable(NULL);
    if (err) {
        LOG_ERR("Bluetooth failed to start (err %d)\n", err);
        return;
    }
    LOG_INF("Bluetooth successfully started\n");
}

/**
 * --- FAST SIMULATION LOOP (Timer Handler) ---
 * Runs every 'coordination.dt' (e.g., 1ms) in an ISR context.
 */
static void dynamics_timer_cb(struct k_timer *dummy) {
    ARG_UNUSED(dummy);
    k_sem_give(&dynamics_sem);
}

static void network_timer_cb(struct k_timer *dummy) {
    ARG_UNUSED(dummy);
    k_sem_give(&network_sem);
}

/**
 * --- DEDICATED FAST AGENT DYNAMICS THREAD ---
 * Runs when signaled by the timer semaphore (P=5).
 */
static void dynamics_thread(void) {
    while (1) {
        k_sem_take(&dynamics_sem, K_FOREVER);

        k_mutex_lock(&coordination_mutex, K_FOREVER);
        if (coordination.running && coordination.enabled) {
            discrete_step(&coordination);
            
            custom_data_type custom_data = {
                MANUFACTURER_ID,
                coordination.enabled ? NETID_ENABLED : NETID_DISABLED,
                coordination.node,
                coordination.vstate
            };
            broadcaster_update_scan_response_custom_data(&custom_data);
        }
        k_mutex_unlock(&coordination_mutex);
    }
}

/**
 * --- SLOW NETWORK/LOGGING LOOP (Thread) ---
 * Driven by network_timer (period = coordination.clock), mirroring the fast
 * dynamics_thread pattern. Supports N consecutive runs without reboot.
 *
 * When running:  network_timer fires every clock ms → k_sem_give → thread wakes.
 * When idle:     network_timer is stopped → k_sem_take times out after 1000 ms
 *                so the thread can still detect a new 't1' trigger promptly.
 */
static void network_fetching_thread(void) {
    static coordination_params log_data_copy;
    static neighbor_info_type  neighbor_info;
    static bool was_running = false;

    while (1) {
        // Idle fallback of 1000 ms: wakes the thread if no timer tick arrives
        // (i.e. while not running) so it can detect a new trigger promptly.
        k_sem_take(&network_sem, K_MSEC(1000));

        // Snapshot shared flags under mutex.
        k_mutex_lock(&coordination_mutex, K_FOREVER);
        bool running    = coordination.running;
        bool first_time = coordination.first_time_running;
        bool observed   = coordination.all_neighbors_observed;
        k_mutex_unlock(&coordination_mutex);

        if (running) {
            if (first_time) {
                // 'n'/'a'/'p' arrive before 't1', so these fields are stable by now.
                custom_data_type initial_data = {
                    MANUFACTURER_ID,
                    coordination.enabled ? NETID_ENABLED : NETID_DISABLED,
                    coordination.node,
                    coordination.vstate
                };
                broadcaster_init(&initial_data);
                observer_init();
                k_timer_start(&dynamics_timer, K_MSEC(0), K_MSEC(coordination.dt));
                k_timer_start(&network_timer,  K_MSEC(coordination.clock), K_MSEC(coordination.clock));

                k_mutex_lock(&coordination_mutex, K_FOREVER);
                coordination.first_time_running = false;
                k_mutex_unlock(&coordination_mutex);

                was_running = true;
            }

            if (observed) {
                // Drain the queue if new BLE data arrived (non-blocking).
                // With BT_LE_SCAN_OPT_FILTER_DUPLICATE the controller reports each
                // address only once per scan session, so for a 1-neighbor directed
                // ring the queue is empty on most ticks. Logging is decoupled so
                // one serial frame is sent every clock tick regardless.
                if (!k_msgq_get(&custom_observer_msg_queue, &neighbor_info, K_NO_WAIT)) {
                    k_mutex_lock(&coordination_mutex, K_FOREVER);
                    if (coordination.enabled) {
                        memcpy(coordination.neighbor_vstates, neighbor_info.vstates, sizeof(neighbor_info.vstates));
                        memcpy(coordination.neighbor_enabled, neighbor_info.enabled, sizeof(neighbor_info.enabled));
                    }
                    k_mutex_unlock(&coordination_mutex);
                }
                // Always log once per network tick, using latest available neighbor state.
                k_mutex_lock(&coordination_mutex, K_FOREVER);
                memcpy(&log_data_copy, &coordination, sizeof(coordination_params));
                k_mutex_unlock(&coordination_mutex);
                serial_log_coordination_task(&log_data_copy);
            }

        } else {
            if (was_running) {
                k_timer_stop(&dynamics_timer);
                k_timer_stop(&network_timer);
                broadcaster_stop();
                observer_stop(); // also purges the message queue
                was_running = false;
            }
        }
    }
}
```

## src/broadcaster.c
```c
#include "broadcaster.h"

// Register the logger for this module
LOG_MODULE_REGISTER(Module_Broadcaster, LOG_LEVEL_INF);

/**
 * Type variable to control many aspects of the advertising 
 * --> it could replace the default advertising parameters given by BT_LE_ADV_NCONN
 */
static const struct bt_le_adv_param *adv_param =
	BT_LE_ADV_PARAM(BT_LE_ADV_OPT_NONE, /* No options specified */
	MIN_ADV_INTERVAL, 
	MAX_ADV_INTERVAL,
	NULL /* Set to NULL for undirected advertising */
); /* Set to NULL for undirected advertising */
            

void set_tx_power(uint8_t handle_type, uint16_t handle, int8_t tx_pwr_lvl)
{
	struct bt_hci_cp_vs_write_tx_power_level *cp; 
	struct bt_hci_rp_vs_write_tx_power_level *rp; 
	struct net_buf *buf, *rsp = NULL; 
	int err; 

	buf = bt_hci_cmd_create(BT_HCI_OP_VS_WRITE_TX_POWER_LEVEL,
		sizeof(*cp));
	if (!buf) {
		LOG_ERR("Unable to allocate command buffer\n");
		return;
	}

	cp = net_buf_add(buf, sizeof(*cp)); 
	cp->handle = sys_cpu_to_le16(handle); 
	cp->handle_type = handle_type; 
	cp->tx_power_level = tx_pwr_lvl; 

	err = bt_hci_cmd_send_sync(BT_HCI_OP_VS_WRITE_TX_POWER_LEVEL,
		buf, &rsp);
	if (err) {
		uint8_t reason = rsp ?
			((struct bt_hci_rp_vs_write_tx_power_level *)rsp->data)->status : 0;
		LOG_ERR("Set Tx power err: %d reason 0x%02X\n", err, reason);
		return;
	}

	rp = (void *)rsp->data;
	LOG_INF("Actual Tx Power: %d\n", rp->selected_tx_power); 
	net_buf_unref(rsp); 
}

/** 
 * Function that initialize the broadcaster with scan response
 */
int broadcaster_init(custom_data_type* custom_data)
{
	struct bt_data ad[] = {
		BT_DATA(BT_DATA_NAME_COMPLETE, DEVICE_NAME, DEVICE_NAME_LEN),
		BT_DATA(BT_DATA_MANUFACTURER_DATA, (unsigned char *)custom_data, sizeof(custom_data_type))
	};

	// Set 8 dBm Tx power
	set_tx_power(BT_HCI_VS_LL_HANDLE_TYPE_ADV, 0, TX_POWER_LEVEL_BLE); 

	// Min adv time is 100ms, max is 150ms for BT_LE_ADV_NCONN
    int err = bt_le_adv_start(adv_param, ad, ARRAY_SIZE(ad), ad, ARRAY_SIZE(ad));
	if (err) {
		LOG_ERR("Advertising failed to start (err %d)\n", err);
		return err;
	}
	LOG_INF("Advertising successfully started\n");
	return 0;
}

/**
 * Function that updates the broadcaster with scan response
 */
int broadcaster_update_scan_response_custom_data(custom_data_type* custom_data)
{
	struct bt_data ad[] = {
		BT_DATA(BT_DATA_NAME_COMPLETE, DEVICE_NAME, DEVICE_NAME_LEN),
		BT_DATA(BT_DATA_MANUFACTURER_DATA, (unsigned char *)custom_data, sizeof(custom_data_type))
	};
	int err = bt_le_adv_update_data(ad, ARRAY_SIZE(ad), ad, ARRAY_SIZE(ad));
	if (err) {
		LOG_ERR("Advertising failed to update (err %d)\n", err);
		return err;
	}

	return 0;
	
}

int broadcaster_stop(void)
{
    int err = bt_le_adv_stop();
    if (err) {
        LOG_ERR("Advertising failed to stop (err %d)", err);
        return err;
    }
    LOG_INF("Advertising stopped");
    return 0;
}
```

## src/broadcaster.h
```c
#ifndef BROADCASTER_H_
#define BROADCASTER_H_

// Include modules
#include <zephyr/bluetooth/bluetooth.h>
#include <zephyr/bluetooth/gap.h>
#include <zephyr/logging/log.h>
#include "common.h"

// Declare public functions
int broadcaster_init(custom_data_type* custom_data);
int broadcaster_update_scan_response_custom_data(custom_data_type* custom_data);

#endif // BROADCASTER_H_
```

## src/consensus.c
```c
#include <math.h>
#include "consensus.h"

#include <zephyr/logging/log.h>
// Register the logger for this module
LOG_MODULE_REGISTER(Module_Consensus, LOG_LEVEL_INF);


static bool available_neighbors[N_MAX_NEIGHBORS] = {false};
static bool neighbor_enabled[N_MAX_NEIGHBORS] = {false};
static uint8_t neighbors[N_MAX_NEIGHBORS] = {0};
static int32_t neighbor_vstates[N_MAX_NEIGHBORS] = {0};

consensus_params consensus; 

void consensus_init(void) {
    consensus.discrete_time          = true;
    consensus.consensual_avg_law     = true;
    consensus.running                = false;                  
    consensus.enabled                = false;                 
    consensus.first_time_running     = true;                    // always true at the begging of the execution              
    consensus.all_neighbors_observed = false;                 
    consensus.available_neighbors    = available_neighbors;    
    consensus.node                   = 0;                     
    consensus.neighbors              = neighbors;              
    consensus.scale_factor           = 1e6f;                    // must be the same as in raspberry/algo.js      
    consensus.inv_scale_factor       = 1e-6f;                   // must be the same as in raspberry/algo.js      
    consensus.N                      = 0;                  
    consensus.time0                  = 0;                
    consensus.Ts                     = 0;                   
    consensus.dt                     = 0;                   
    consensus.state0                 = 0;               
    consensus.vstate0                = 0;              
    consensus.vartheta0              = 0;            
    consensus.alpha                  = 0;                
    consensus.eta                    = 0;                  
    consensus.delta                  = 0;                
    consensus.state                  = 0;                
    consensus.vstate                 = 0;               
    consensus.vartheta               = 0;             
    consensus.active                 = 0;               
    consensus.epsilonON              = 0.01f;                   // must be the same as in raspberry/algo.js         
    consensus.epsilonOFF             = 0.05f;                   // must be the same as in raspberry/algo.js
    consensus.neighbor_enabled       = neighbor_enabled;       
    consensus.neighbor_vstates       = neighbor_vstates;      
    consensus.disturbance            = (disturbance_params){false, 0, 0, 0, 0, 0, 0, 0, 0};  
}


float disturbance(consensus_params* cp) {
    float nu = 0.0f;
    if (!cp->disturbance.disturbance_on) {
        nu = 0.0f; 
    } else {
        // Scaling factors
        float amp = (float)cp->disturbance.amplitude * cp->inv_scale_factor;
        float off = (float)cp->disturbance.offset * cp->inv_scale_factor;
        float beta = (float)cp->disturbance.beta * cp->inv_scale_factor;
        float A = (float)cp->disturbance.A * cp->inv_scale_factor; 
        float f = (float)cp->disturbance.frequency;                                    
        float phi_shift_s = (float)cp->disturbance.phase * cp->inv_scale_factor;       
        float t = (float)cp->disturbance.counter * (float)cp->dt * cp->inv_scale_factor; // dt must be scaled to seconds
        float m = amp * ((float)rand() / (float)RAND_MAX - off); 
        float sinusoidal = A * sinf(2.0f * M_PI * f * (t - phi_shift_s));
        nu = m + beta + sinusoidal;
    } 
    return nu; 
}

float sign(float x) {
    if (x > 0.0f) {
        return 1.0f;
    } else if (x < 0.0f) {
        return -1.0f;
    } else {
        return 0.0f;
    }
}

float max_of_two_non_negative_f(float a, float b) {
    float max_val = fmaxf(a, b);
    return fmaxf(0.0f, max_val); 
}

/**
 * Javier's coordination control law: g_i(z_i, v_i)
 */
float v_i(consensus_params* cp) {
    float vstate_f = (float)(cp->vstate * cp->inv_scale_factor);
    float vi = 0.0f;
    for (int j = 0; j < cp->N; j++) {
        if (cp->neighbor_enabled[j]) {
            float diff = vstate_f - (float)(cp->neighbor_vstates[j] * cp->inv_scale_factor);
            vi += -1.0f * sign(diff) * sqrtf(fabsf(diff));
        }
    }
    return vi;
}

/**
 * Consensus average control law: g_i(z_i, v_i)
 * - Assumes strongly connected and balanced graph to reach average consensus
 */
float g_i(consensus_params* cp){
    float z_f = (float)(cp->vstate * cp->inv_scale_factor);
    float vi = 0.0f; 
    for (int j = 0; j < cp->N; j++) {
        if (cp->neighbor_enabled[j]) {
            float diff = z_f - (float)(cp->neighbor_vstates[j] * cp->inv_scale_factor);
            vi += -1.0f * diff;
        }
    }
    return vi;
}

void discrete_step(consensus_params* cp) {
    /**
     * Intended to be run at the same frequency as the fetching of neighbor states
     * No time scaling is applied here. 
     */
    float dt = (float)(cp->dt) * 1e-3f; // Convert ms to seconds
    float x = (float)(cp->state * cp->inv_scale_factor);
    float z = (float)(cp->vstate * cp->inv_scale_factor);
    float vartheta = (float)(cp->vartheta * cp->inv_scale_factor);

    float eta = (float)(cp->eta * cp->inv_scale_factor);      
    float alpha = (float)(cp->alpha * cp->inv_scale_factor);   

    float delta = (float)(cp->delta * cp->inv_scale_factor);   

    float nu = disturbance(cp) * dt; 
    float sigma = x - z;
    float grad = sign(sigma);
    
    float gi = 0.0; 
    if (cp->consensual_avg_law) {
        gi = g_i(cp);
    } else { // Javier's law
        gi = v_i(cp);
    }
    gi = alpha * gi; // if (average consensus law) else v_i(cp) if (Javier's law)

    float u = gi - vartheta * grad;

    float dvtheta = (fabsf(sigma) > delta) ? 1.0f : 0.0f;

    cp->state = (int32_t)(max_of_two_non_negative_f(x + u + nu, 0.0f) * cp->scale_factor);
    cp->vstate = (int32_t)(max_of_two_non_negative_f(z + gi, 0.0f) * cp->scale_factor);
    // Fixed-point rounding for (uint32_t)((vartheta + eta * dvtheta) * cp->scale_factor);
    uint32_t eta_dvtheta = (uint32_t)(eta * dvtheta * cp->scale_factor);
    cp->vartheta += eta_dvtheta;
    cp->disturbance.counter = (cp->disturbance.counter + 1) % cp->disturbance.samples;
}

void update_consensus(consensus_params* cp) {
    float dt = (float)(cp->dt) * 1e-3f; // Convert ms to seconds
    float x = (float)(cp->state * cp->inv_scale_factor);
    float z = (float)(cp->vstate * cp->inv_scale_factor);
    float vartheta = (float)(cp->vartheta * cp->inv_scale_factor);
    float eta = (float)(cp->eta * cp->inv_scale_factor);

    float nu = disturbance(cp);
    float sigma = x - z; 
    float grad = sign(sigma); 
    float vi = v_i(cp);
    float gi = vi; 
    float ui = gi - vartheta * grad; 

    float dvtheta = 0.0f; 
    if (cp->active == 0){ 
        if ((float)fabs(sigma) > cp->epsilonON){
            cp->active = 1;
            dvtheta = eta * 1.0f; 
        } else {
            dvtheta = 0.0f; 
        }
    } else {
        if ((float)fabs(sigma) <= cp->epsilonOFF){
            cp->active = 0;
            dvtheta = 0.0f; 
        } else {
            dvtheta = eta * 1.0f; 
        }
    }
    cp->state = (int32_t)(max_of_two_non_negative_f(x + dt * (ui + nu), 0.0f) * cp->scale_factor);
    cp->vstate = (int32_t)(max_of_two_non_negative_f(z + dt * gi, 0.0f) * cp->scale_factor);
    cp->vartheta = (int32_t)(max_of_two_non_negative_f(vartheta + dt * dvtheta, 0.0f) * cp->scale_factor);
    cp->disturbance.counter = (cp->disturbance.counter + 1) % cp->disturbance.samples;
}
```

## src/consensus.h
```c
#ifndef CONSENSUS_H
#define CONSENSUS_H

#include <stdlib.h>
#include <stdint.h>
#include <zephyr/kernel.h>
#include "common.h"

#define M_PI 3.14159265358979323846f

/**
 * Custom type to store disturbance parameters sent by user through UART
 */
typedef struct {
    bool disturbance_on; 
    // Uniform disturbance parameters:
    int32_t offset;
    int32_t amplitude;
    // Constant disturbance parameter:
    int32_t beta;
    // Sinusoidal disturbance parameters:
    int32_t A;
    int32_t frequency;
    int32_t phase; 
    uint32_t counter; 
    uint32_t samples; 
} disturbance_params;

/**
 * Custom type to store consensus parameters sent by user through UART 
 * - TODO: change the name since it is not only consensus anymore, could be any coordination task
 */
typedef struct {
    bool discrete_time;                // whether the consensus algorithm is in discrete time or continuous time (Euler integration) **(NEW)
    bool consensual_avg_law;           // whether to use the consensual average law or Javier's law **(NEW)
    bool running;                      // whether the consensus algorithm is running or not
    bool enabled;                      // whether the consensus algorithm is enabled or not
    bool first_time_running;           // to initialize: first broadcasting, observing, timer start
    bool all_neighbors_observed;       // to check if all neighbors have been observed at least once
    bool* available_neighbors;         // array to track which neighbors have been observed
    uint8_t node;                      // node ID
    uint8_t* neighbors;                // array of neighbor IDs
    float scale_factor;                // scaling factor for fixed-point representation: 1.0f --> (uint32_t) 1e6
    float inv_scale_factor;            // inverse of the scaling factor: (uint32_t) 1e6 --> 1.0f
    uint8_t N;                         // number of neighbors
    int64_t time0;                     // internal clock time0   
    int32_t Ts;                        // network fetching period (ms)
    int32_t dt;                        // dynamics timer and integration step (if Euler Solver is used) (ms)
    int32_t state0;                    // initial state
    int32_t vstate0;                   // initial vstate
    int32_t vartheta0;                 // initial vartheta
    int32_t alpha;                     // coordination task control gain (discrete time) --> vstates: z **(NEW)
    int32_t eta;                       // adaptation gain for vartheta 
    int32_t delta;                     // threshold for vartheta update (discrete time) **(NEW)
    int32_t state;                     // current state
    int32_t vstate;                    // current vstate
    int32_t vartheta;                  // current vartheta
    uint8_t active;                    // (hysteresis rule) whether the adaptation is active or not
    float epsilonON;                   // threshold to turn ON the adaptation
    float epsilonOFF;                  // threshold to turn OFF the adaptation
    bool* neighbor_enabled;            // array to track which neighbors are enabled
    int32_t* neighbor_vstates;         // array to store neighbor vstates
    disturbance_params disturbance;    // disturbance parameters
} consensus_params;

/**
 * Global consensus parameters instance
 */
extern consensus_params consensus;

/**
 * TODO: change the name since it is not only consensus anymore, could be any coordination task
 */
void consensus_init(void); 

float sign(float x);
float max_of_two_non_negative_f(float a, float b);
float disturbance(consensus_params* cp);
float v_i(consensus_params* cp);
float g_i(consensus_params* cp); 
void discrete_step(consensus_params* cp);
void update_consensus(consensus_params* cp);


#endif // CONSENSUS_H
```

## src/coordination_task.c
```c
#include <math.h>
#include "coordination_task.h"

#include <zephyr/logging/log.h>
// Register the logger for this module
LOG_MODULE_REGISTER(Module_Consensus, LOG_LEVEL_INF);


static bool available_neighbors[N_MAX_NEIGHBORS] = {false};
static bool neighbor_enabled[N_MAX_NEIGHBORS] = {false};
static uint8_t neighbors[N_MAX_NEIGHBORS] = {0};
static int32_t neighbor_vstates[N_MAX_NEIGHBORS] = {0};

/**
 *  Global cooridination parameters instance
 */
coordination_params coordination; 

void coordination_params_init(void) {
    coordination.consensual_avg_law     = false;
    coordination.running                = false;                  
    coordination.enabled                = false;                 
    coordination.first_time_running     = true;                    // always true at the begging of the execution              
    coordination.all_neighbors_observed = false;                 
    coordination.available_neighbors    = available_neighbors;    
    coordination.node                   = 0;                     
    coordination.neighbors              = neighbors;              
    coordination.scale_factor           = 1e6f;                    // must be the same as in raspberry/algo.js      
    coordination.inv_scale_factor       = 1e-6f;                   // must be the same as in raspberry/algo.js      
    coordination.N                      = 0;                  
    coordination.time0                  = 0;                
    coordination.Ts                     = 0;                   
    coordination.dt                     = 0;                   
    coordination.state0                 = 0;               
    coordination.vstate0                = 0;              
    coordination.vartheta0              = 0;            
    coordination.alpha                  = 0;                
    coordination.eta                    = 0;                  
    coordination.delta                  = 0;                
    coordination.state                  = 0;                
    coordination.vstate                 = 0;               
    coordination.vartheta               = 0;             
    coordination.active                 = 0;               
    coordination.epsilonON              = 0.01f;                   // must be the same as in raspberry/algo.js         
    coordination.epsilonOFF             = 0.05f;                   // must be the same as in raspberry/algo.js
    coordination.neighbor_enabled       = neighbor_enabled;       
    coordination.neighbor_vstates       = neighbor_vstates;      
    coordination.disturbance            = (disturbance_params){false, 0, 0, 0, 0, 0, 0, 0, 0};  
}


float disturbance(coordination_params* cp) {
    float nu = 0.0f;
    if (!cp->disturbance.disturbance_on) {
        nu = 0.0f; 
    } else {
        // Scaling factors
        float amp = (float)cp->disturbance.amplitude * cp->inv_scale_factor;
        float off = (float)cp->disturbance.offset * cp->inv_scale_factor;
        float beta = (float)cp->disturbance.beta * cp->inv_scale_factor;
        float A = (float)cp->disturbance.A * cp->inv_scale_factor; 
        float f = (float)cp->disturbance.frequency;                                    
        float phi_shift_s = (float)cp->disturbance.phase * cp->inv_scale_factor;       
        float t = (float)cp->disturbance.counter * (float)cp->dt * cp->inv_scale_factor; // dt must be scaled to seconds
        float m = amp * ((float)rand() / (float)RAND_MAX - off); 
        float sinusoidal = A * sinf(2.0f * M_PI * f * (t - phi_shift_s));
        nu = m + beta + sinusoidal;
    } 
    return nu; 
}

float sign(float x) {
    if (x > 0.0f) {
        return 1.0f;
    } else if (x < 0.0f) {
        return -1.0f;
    } else {
        return 0.0f;
    }
}

float max_of_two_non_negative_f(float a, float b) {
    float max_val = fmaxf(a, b);
    return fmaxf(0.0f, max_val); 
}

/**
 * Javier's coordination control law: g_i(z_i, v_i)
 */
float v_i(coordination_params* cp) {
    float vstate_f = (float)(cp->vstate * cp->inv_scale_factor);
    float vi = 0.0f;
    for (int j = 0; j < cp->N; j++) {
        if (cp->neighbor_enabled[j]) {
            float diff = vstate_f - (float)(cp->neighbor_vstates[j] * cp->inv_scale_factor);
            vi += -1.0f * sign(diff) * sqrtf(fabsf(diff));
        }
    }
    return vi;
}

/**
 * Consensus average control law: g_i(z_i, v_i)
 * - Assumes strongly connected and balanced graph to reach average consensus
 */
float g_i(coordination_params* cp){
    float z_f = (float)(cp->vstate * cp->inv_scale_factor);
    float vi = 0.0f; 
    for (int j = 0; j < cp->N; j++) {
        if (cp->neighbor_enabled[j]) {
            float diff = z_f - (float)(cp->neighbor_vstates[j] * cp->inv_scale_factor);
            vi += -1.0f * diff;
        }
    }
    return vi;
}

void discrete_step(coordination_params* cp) {
    /**
     * Intended to be run at the same frequency as the fetching of neighbor states
     * No time scaling is applied here. 
     */
    float dt = (float)(cp->dt) * 1e-3f; // Convert ms to seconds
    float x = (float)(cp->state * cp->inv_scale_factor);
    float z = (float)(cp->vstate * cp->inv_scale_factor);
    float vartheta = (float)(cp->vartheta * cp->inv_scale_factor);

    float eta = (float)(cp->eta * cp->inv_scale_factor);      
    float alpha = (float)(cp->alpha * cp->inv_scale_factor);   

    float delta = (float)(cp->delta * cp->inv_scale_factor);   

    float nu = disturbance(cp) * dt; 
    float sigma = x - z;
    float grad = sign(sigma);
    
    float gi = 0.0; 
    if (cp->consensual_avg_law) {
        gi = g_i(cp);
    } else { // Javier's law
        gi = v_i(cp);
    }
    gi = alpha * gi; // if (average consensus law) else v_i(cp) if (Javier's law)

    float u = gi - vartheta * grad;

    float dvtheta = (fabsf(sigma) > delta) ? 1.0f : 0.0f;

    cp->state = (int32_t)((x + u + nu) * cp->scale_factor);
    cp->vstate = (int32_t)((z + gi) * cp->scale_factor);
    // Fixed-point rounding for (uint32_t)((vartheta + eta * dvtheta) * cp->scale_factor);
    uint32_t eta_dvtheta = (uint32_t)(eta * dvtheta * cp->scale_factor);
    cp->vartheta += eta_dvtheta;
    cp->disturbance.counter = (cp->disturbance.counter + 1) % cp->disturbance.samples;
}

void update_coordination(coordination_params* cp) {
    float dt = (float)(cp->dt) * 1e-3f; // Convert ms to seconds
    float x = (float)(cp->state * cp->inv_scale_factor);
    float z = (float)(cp->vstate * cp->inv_scale_factor);
    float vartheta = (float)(cp->vartheta * cp->inv_scale_factor);
    float eta = (float)(cp->eta * cp->inv_scale_factor);
    float alpha = (float)(cp->alpha * cp->inv_scale_factor);

    float nu = disturbance(cp);
    float sigma = x - z; 
    float grad = sign(sigma); 

    float gi = 0.0; 
    if (cp->consensual_avg_law) {
        gi = g_i(cp);
    } else { // Javier's law
        gi = v_i(cp);
    }

    gi = alpha * gi; // if (average consensus law) else v_i(cp) if (Javier's law)
    float ui = gi - vartheta * grad; 

    float dvtheta = 0.0f; 
    if (cp->active == 0){ 
        if ((float)fabs(sigma) > cp->epsilonON){
            cp->active = 1;
            dvtheta = eta * 1.0f; 
        } else {
            dvtheta = 0.0f; 
        }
    } else {
        if ((float)fabs(sigma) <= cp->epsilonOFF){
            cp->active = 0;
            dvtheta = 0.0f; 
        } else {
            dvtheta = eta * 1.0f; 
        }
    }
    cp->state = (int32_t)((x + dt * (ui + nu)) * cp->scale_factor);
    cp->vstate = (int32_t)((z + dt * gi) * cp->scale_factor);
    cp->vartheta = (int32_t)((vartheta + dt * dvtheta) * cp->scale_factor);
    cp->disturbance.counter = (cp->disturbance.counter + 1) % cp->disturbance.samples;
}
```

## src/coordination_task.h
```c
#ifndef COORDINATION_TASK_H
#define COORDINATION_TASK_H

#include <stdlib.h>
#include <stdint.h>
#include <zephyr/kernel.h>
#include "common.h"

#define M_PI 3.14159265358979323846f

/**
 * Custom type to store disturbance parameters sent by user through UART
 */
typedef struct {
    bool disturbance_on; 
    // Uniform disturbance parameters:
    int32_t offset;
    int32_t amplitude;
    // Constant disturbance parameter:
    int32_t beta;
    // Sinusoidal disturbance parameters:
    int32_t A;
    int32_t frequency;
    int32_t phase; 
    uint32_t counter; 
    uint32_t samples; 
} disturbance_params;

/**
 * Custom type to store coordination parameters sent by user through UART 
 */
typedef struct {
    bool consensual_avg_law;           // whether to use the consensual asymptotic average law or Javier's law 
    bool running;                      // whether the coordination algorithm is running or not
    bool enabled;                      // whether the coordination algorithm is enabled or not
    bool first_time_running;           // to initialize: first broadcasting, observing, timer start
    bool all_neighbors_observed;       // to check if all neighbors have been observed at least once
    bool* available_neighbors;         // array to track which neighbors have been observed
    uint8_t node;                      // node ID
    uint8_t* neighbors;                // array of neighbor IDs
    float scale_factor;                // scaling factor for fixed-point representation: 1.0f --> (uint32_t) 1e6
    float inv_scale_factor;            // inverse of the scaling factor: (uint32_t) 1e6 --> 1.0f
    uint8_t N;                         // number of neighbors
    int64_t time0;                     // internal clock time0   
    int32_t Ts;                        // network fetching period (ms)
    int32_t dt;                        // dynamics timer and integration step (if Euler Solver is used) (ms)
    int32_t state0;                    // initial state
    int32_t vstate0;                   // initial vstate
    int32_t vartheta0;                 // initial vartheta
    int32_t alpha;                     // coordination task control gain (discrete time) --> vstates: z **(NEW)
    int32_t eta;                       // adaptation gain for vartheta 
    int32_t delta;                     // threshold for vartheta update (discrete time) **(NEW)
    int32_t state;                     // current state
    int32_t vstate;                    // current vstate
    int32_t vartheta;                  // current vartheta
    uint8_t active;                    // (hysteresis rule) whether the adaptation is active or not
    float epsilonON;                   // threshold to turn ON the adaptation
    float epsilonOFF;                  // threshold to turn OFF the adaptation
    bool* neighbor_enabled;            // array to track which neighbors are enabled
    int32_t* neighbor_vstates;         // array to store neighbor vstates
    disturbance_params disturbance;    // disturbance parameters
} coordination_params;

/**
 * Global coordination parameters instance
 */
extern coordination_params coordination;

void coordination_params_init(void); 
float sign(float x);
float max_of_two_non_negative_f(float a, float b);
float disturbance(coordination_params* cp);
float v_i(coordination_params* cp);
float g_i(coordination_params* cp); 
void discrete_step(coordination_params* cp);
void update_coordination(coordination_params* cp);

#endif // COORDINATION_TASK_H
```

## src/observer.c
```c
#include "observer.h"

// Register the logger for this module
LOG_MODULE_REGISTER(Module_Observer, LOG_LEVEL_INF);

// Internal module variables                               
static neighbor_info_type neighbor_info;
K_MSGQ_DEFINE(custom_observer_msg_queue, sizeof(neighbor_info_type), 1, 4);	// define the queue (the size of the queue is 1)

/**
 * Function to map NEIGHBOR_i_IDs to their respective indices
 */
static int8_t map_node_to_index(uint8_t node) {
	for (int i = 0; i < coordination.N; i++) {
		if (coordination.neighbors[i] == node) {
			return i;
		}
	}
	return -1;
}

/** 
 * Private Callback: On data parsed (called after device has been found)
 */
static bool on_data_parse_after_device_found(struct bt_data *data, void *user_data) {
	custom_data_type *custom_data = user_data;
	switch (data->type) {

		// When getting the manufacturer data (since it can be placed in broadcasting or in scan_response):
		case BT_DATA_MANUFACTURER_DATA:
			if (data->data_len == CUSTOM_DATA_TYPE_SIZE) {
				memcpy(custom_data, data->data, CUSTOM_DATA_TYPE_SIZE);

				// Make sure the data is of our network
				if (custom_data->manufacturer == MANUFACTURER_ID && (custom_data->netid_enabled == NETID_ENABLED || custom_data->netid_enabled == NETID_DISABLED)) { 
					int8_t node_index = map_node_to_index(custom_data->node);

					if (node_index >= 0) {
					    if (!coordination.all_neighbors_observed) {
					    	coordination.available_neighbors[node_index] = true;
					    	int N = 0;
					    	for (int i = 0; i < coordination.N; i++) {
					    		if (coordination.available_neighbors[i]) {
					    			N++;
					    		}
					    	}
					    	if (N == coordination.N) {
					    		coordination.all_neighbors_observed = true;
					    	}
					    }

					    // Update the message queue with the state value of the node (it only updates the place of a node in the array of neighbor values)
                        neighbor_info.vstates[node_index] = custom_data->vstate; 
					    neighbor_info.enabled[node_index] = (custom_data->netid_enabled == NETID_ENABLED) ? true : false;

					    while (k_msgq_put(&custom_observer_msg_queue, &neighbor_info, K_NO_WAIT) != 0) {
            		    	k_msgq_purge(&custom_observer_msg_queue);		// This logic deletes previous state values in the queue
        			    }
					    LOG_DBG("id: %d, vstate: %d, enabled: %d", custom_data->node, neighbor_info.vstates[node_index], neighbor_info.enabled[node_index]);
					}
				}
			}
			return false;

		default:
			return true;
	}
}

/**
 * Private Callback: On device found (it just call the parser)
 */
static void on_device_found(const bt_addr_le_t *addr, int8_t rssi, uint8_t type, struct net_buf_simple *ad) {
	// Parse the scanned data to a parse callback
	char ad_parsed[BT_GAP_ADV_MAX_ADV_DATA_LEN];
	bt_data_parse(ad, on_data_parse_after_device_found, ad_parsed);
}

/**
 * Public function: start the observer 
 */
int observer_init(void) {
	struct bt_le_scan_param scan_param = {
		.type       = BT_LE_SCAN_TYPE_ACTIVE,			// This enables to send scan requests
		.options    = BT_LE_SCAN_OPT_FILTER_DUPLICATE,
		.interval   = BT_GAP_SCAN_FAST_INTERVAL,
		.window     = BT_GAP_SCAN_FAST_WINDOW,
	};
	int err = bt_le_scan_start(&scan_param, on_device_found);
	if (err) {
		LOG_ERR("Scanning failed to start (err %d)\n", err);
		return err;
	}
	LOG_INF("Scanning successfully started\n");
	return 0;
}


int observer_stop(void)
{
    int err = bt_le_scan_stop();
    if (err) {
        LOG_ERR("Scanning failed to stop (err %d)", err);
        return err;
    }
    k_msgq_purge(&custom_observer_msg_queue);
    LOG_INF("Scanning stopped, message queue purged");
    return 0;
}
```

## src/observer.h
```c
#ifndef OBSERVER_H_
#define OBSERVER_H_

// Include modules
#include <zephyr/bluetooth/bluetooth.h>
#include <zephyr/bluetooth/hci.h>
#include <zephyr/logging/log.h>
#include "common.h"
#include "coordination_task.h"
#include "serial.h"

// Define a type for the message queue
typedef struct {
    int32_t vstates[N_MAX_NEIGHBORS];   // to store the virtual state of the neighbors 
    bool enabled[N_MAX_NEIGHBORS];      // to store whether the neighbor is enabled or not
} neighbor_info_type;

// Declare the message queue as extern to be used outside the observer module
extern struct k_msgq custom_observer_msg_queue;

// Declare public functions
int observer_init(void);

#endif // OBSERVER_H_
```

## src/serial.h
```c
#ifndef SERIAL_H 
#define SERIAL_H

#include <stdlib.h>
#include <string.h> 
#include <zephyr/kernel.h>
#include <zephyr/logging/log.h>
#include <zephyr/drivers/uart.h>
#include <zephyr/device.h>
#include <zephyr/devicetree.h>
#include "common.h"
#include "coordination_task.h"

// Definitions
#define TX_BUFF_SIZE    64
#define RX_BUFF_SIZE    64
#define RX_TIMEOUT      50000   //50000us = 50ms = 0.05s. If this is too small, then we will not receive a full string from application

// Declare public functions
void serial_init(void);
void serial_log_coordination_task(coordination_params* coordination);

#endif // SERIAL_H
```
